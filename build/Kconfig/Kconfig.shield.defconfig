## build/Kconfig/arch/Kconfig
```kconfig
# Load Zephyr Arch Kconfig descriptions.
osource "C:/ncs/zephyr/arch/rx/Kconfig"
osource "C:/ncs/zephyr/arch/x86/Kconfig"
osource "C:/ncs/zephyr/arch/xtensa/Kconfig"
osource "C:/ncs/zephyr/arch/sparc/Kconfig"
osource "C:/ncs/zephyr/arch/riscv/Kconfig"
osource "C:/ncs/zephyr/arch/posix/Kconfig"
osource "C:/ncs/zephyr/arch/mips/Kconfig"
osource "C:/ncs/zephyr/arch/arm64/Kconfig"
osource "C:/ncs/zephyr/arch/arm/Kconfig"
osource "C:/ncs/zephyr/arch/arc/Kconfig"
```

## build/Kconfig/boards/Kconfig
```kconfig
# Load Zephyr board Kconfig descriptions.
osource "C:/ncs/zephyr/boards/rakwireless/rak5010/Kconfig"
```

## build/Kconfig/boards/Kconfig.defconfig
```kconfig
# Load Zephyr board defconfig descriptions.
osource "C:/ncs/zephyr/boards/rakwireless/rak5010/Kconfig.defconfig"
```

## build/Kconfig/boards/Kconfig.rak5010
```kconfig
# Load board Kconfig descriptions.
osource "C:/ncs/zephyr/boards/rakwireless/rak5010/Kconfig.rak5010"
```

## build/Kconfig/boards/Kconfig.sysbuild
```kconfig
# Load Sysbuild board Kconfig descriptions.
osource "C:/ncs/zephyr/boards/rakwireless/rak5010/Kconfig.sysbuild"
```
